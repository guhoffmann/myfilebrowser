## conf/local.conf
```bitbake
# Minimal lighttpd configuration file for myfilebrowser!

server.modules = ( 
    "mod_fastcgi",
    "mod_cgi",
    "mod_rewrite"
)

server.document-root = "/home/uwe/MyDevelop/MyWeb/myfilebrowser" 
server.errorlog = "/home/uwe/MyDevelop/MyWeb/myfilebrowser/error.log" 
server.pid-file = "/home/uwe/MyDevelop/MyWeb/myfilebrowser/myfilebrowser.pid" 
server.port = 2080
index-file.names = ( "index.html", "index.htm" )
static-file.exclude-extensions = ( ".php" )

mimetype.assign = (  
    ".pdf"   => "application/pdf",
    ".class" => "application/octet-stream",
    ".pac"   => "application/x-ns-proxy-autoconfig",
    ".swf"   => "application/x-shockwave-flash",
    ".wav"   => "audio/x-wav",
    ".gif"   => "image/gif",
    ".jpg"   => "image/jpeg",
    ".jpeg"  => "image/jpeg",
    ".png"   => "image/png",
    ".svg"   => "image/svg+xml",
    ".css"   => "text/css",
    ".html"  => "text/html",
    ".htm"   => "text/html",
    ".js"    => "text/javascript",
    ".txt"   => "text/plain",
    ".dtd"   => "text/xml",
    ".7z"    => "application/zip",
    ".xml"   => "text/xml" 
 )

fastcgi.server = ( ".php" => ((
 "bin-path" => "/usr/bin/php-cgi",
 "socket" => "/home/uwe/MyDevelop/MyWeb/myfilebrowser/php.socket"
 )))
 
```
